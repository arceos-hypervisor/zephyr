## boards/phytium/phytiumpi_axvisor_guest/Kconfig.defconfig
```kconfig
if BOARD_PHYTIUMPI_AXVISOR_GUEST

config BUILD_OUTPUT_BIN
	default y

config MAIN_STACK_SIZE
	default 4096

config ARMV8_A_NS
	default y

config XIP
	default n

config FLASH_SIZE
	default 0

config FLASH_BASE_ADDRESS
	default 0x0

config SERIAL
	default y

config CONSOLE
	default y

config UART_CONSOLE
	default y

config UART_INTERRUPT_DRIVEN
	default y

config CACHE_MANAGEMENT
	default y

config TIMER_READS_ITS_FREQUENCY_AT_RUNTIME
	default y

endif # BOARD_PHYTIUMPI_AXVISOR_GUEST
```

## boards/phytium/phytiumpi_axvisor_guest/board.yml
```yaml
board:
  name: phytiumpi_axvisor_guest
  full_name: Phytium Pi AxVisor Guest
  vendor: phytium
  socs:
  - name: qemu_cortex_a53
```

## boards/xunlong/orangepi_5_plus_rk3588/board.yml
```yaml
board:
  name: orangepi_5_plus_rk3588
  full_name: Orange Pi 5 Plus RK3588
  vendor: xunlong
  socs:
  - name: rk3588
```

## tests/benchmarks/latency_measure/Kconfig
```kconfig
# Copyright (c) 2024 Intel Corporation
# SPDX-License-Identifier: Apache-2.0

mainmenu "Latency Measure Benchmark"

source "Kconfig.zephyr"

config BENCHMARK_NUM_ITERATIONS
	int "Number of iterations to gather data"
	default 1000

config BENCHMARK_SKIP_THREAD_YIELD
	bool "Skip k_yield thread switch benchmarks"
	default n

config BENCHMARK_SKIP_INT_TO_THREAD
	bool "Skip interrupt-to-thread latency benchmarks"
	default n
```

## tests/benchmarks/latency_measure/boards/phytiumpi_axvisor_guest.conf
```kconfig
CONFIG_ARM64_VA_BITS_42=y
CONFIG_ARM64_PA_BITS_42=y
CONFIG_TEST=y
CONFIG_QEMU_ICOUNT=n
CONFIG_ARM_ARCH_TIMER=y
CONFIG_TIMING_FUNCTIONS=y
CONFIG_EVENTS=y
CONFIG_IRQ_OFFLOAD=y
CONFIG_HEAP_MEM_POOL_SIZE=16384
```

## tests/benchmarks/latency_measure/boards/qemu_cortex_a53.conf
```kconfig
CONFIG_BENCHMARK_SKIP_THREAD_YIELD=y
CONFIG_BENCHMARK_SKIP_INT_TO_THREAD=y
CONFIG_QEMU_ICOUNT=n
CONFIG_TIMER_READS_ITS_FREQUENCY_AT_RUNTIME=y
```
